for ( เริ่มต้น ; เงื่อนไข ; การเพิ่มค่า ) {
    // คำสั่งที่จะทำซ้ำ
}


//////////////////////////////////////////////////////////////////////////


void setup() {
  Serial.begin(9600);
  
  // สอน: เริ่มที่ 0; ทำถ้ายังน้อยกว่าหรือเท่ากับ 10; เพิ่มทีละ 1
  for (int i = 0; i <= 10; i++) {
    Serial.print("Count: ");
    Serial.println(i);
    delay(500); // หน่วงเวลาให้เห็นตัวเลขค่อยๆ ไหล
  }
}

void loop() {
  // ว่างไว้
}



///////////////////////////////////////////////////////////////////////////

#include <Servo.h>

Servo myservo; 

void setup() {
  myservo.attach(9); // สมมติ Servo ต่อขา 9
}

void loop() {
  // 1. ขาไป (0 -> 180)
  // อธิบาย: i คือองศา ค่อยๆ เพิ่มทีละ 1
  for (int i = 0; i <= 180; i++) { 
    myservo.write(i); // สั่ง Servo ไปที่องศา i
    delay(15);        // ***ตัวสำคัญ*** ยิ่งเลขเยอะ ยิ่งสมูท/ช้า
    delay 
  }
  
  delay(1000); // พักแปปนึง

  // 2. ขากลับ (180 -> 0)
  // อธิบาย: ต้องลดค่าลง ใช้ i--
  for (int i = 180; i >= 0; i--) { 
    myservo.write(i);
    delay(15);
  }
  
  delay(1000);
}